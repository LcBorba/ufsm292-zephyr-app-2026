## CMakeLists.txt
```
#-------------------------------------------------------------------------------
# Radio RX testbed (SAM R21 only)
#
# Copyright (c) 2026
# SPDX-License-Identifier: Apache-2.0

cmake_minimum_required(VERSION 3.13.1)

# This workspace does not assume a Zephyr SDK is installed. Default to the
# system arm-none-eabi toolchain (gnuarmemb) so the SAM R21 board builds
# out of the box. Still overridable via -DZEPHYR_TOOLCHAIN_VARIANT=... or the
# environment.
if(NOT DEFINED ZEPHYR_TOOLCHAIN_VARIANT AND NOT DEFINED ENV{ZEPHYR_TOOLCHAIN_VARIANT})
  set(ZEPHYR_TOOLCHAIN_VARIANT gnuarmemb)
endif()

find_package(Zephyr REQUIRED HINTS $ENV{ZEPHYR_BASE})

project(radio_rx_testbed LANGUAGES C)

target_sources(app PRIVATE src/main.c)

# The code below locates the git index file for this repository and adds it as a dependency for
# the application VERSION file so that if the repo has a new commit added, even if no files in
# the build have changed, the application version file will be regenerated with the new git commit
find_package(Git QUIET)
if(GIT_FOUND)
  execute_process(
    COMMAND ${GIT_EXECUTABLE} rev-parse --absolute-git-dir
    WORKING_DIRECTORY .
    OUTPUT_VARIABLE application_git_dir
    OUTPUT_STRIP_TRAILING_WHITESPACE
    ERROR_STRIP_TRAILING_WHITESPACE
    ERROR_VARIABLE stderr
    RESULT_VARIABLE return_code
  )
  # If there is an error e.g. it is not a git repo, we just silently ignore it and continue
  # without a dependency, this will be the case with freestanding applications.
  if(NOT return_code)
    if(NOT "${stderr}" STREQUAL "")
      message(WARNING "Application build version git rev-parse warned: ${stderr}")
    endif()

    set_property(TARGET app_version_h PROPERTY APP_VERSION_DEPENDS ${application_git_dir}/index)
  endif()
endif()
```

## Kconfig
```
# Copyright (c) 2026
# SPDX-License-Identifier: Apache-2.0
#
# This file is the application Kconfig entry point. All application Kconfig
# options can be defined here or included via other application Kconfig files.
# You can browse these options using the west targets menuconfig (terminal) or
# guiconfig (GUI).

menu "Zephyr"
source "Kconfig.zephyr"
endmenu

module = RADIO_RX_TESTBED
module-str = RADIO_RX_TESTBED
source "subsys/logging/Kconfig.template.log_config"
```

## prj.conf
```kconfig
# Copyright (c) 2026
# SPDX-License-Identifier: Apache-2.0
#
# Radio RX testbed for the SAM R21 Xplained Pro (samr21_xpro only).
# Raw 802.15.4 mode: the rf2xx driver hands received frames to the app via
# net_recv_data() (the net stack compiles to net_pkt.c only in raw mode).
# Promiscuous mode is enabled so any on-channel frame is accepted; the
# production gateway will use a PAN filter instead (lib/radio/RX-PLAN.md §4).

CONFIG_NETWORKING=y
CONFIG_IEEE802154=y
CONFIG_IEEE802154_RAW_MODE=y
# RAW_MODE defaults IEEE802154_L2_PKT_INCL_FCS to y, which makes the rf2xx
# driver hand us the 2-byte FCS as part of the PSDU (ieee802154_rf2xx.c only
# strips it when this is n). sensor_frame_decode() requires the FCS to be
# already removed (18-byte payload, not 20), so turn it off explicitly.
# Without this every frame lands in `malformed` and LED0 never blinks.
CONFIG_IEEE802154_L2_PKT_INCL_FCS=n
# net_recv_data() runs on the driver's RX thread and does decode + hexdump +
# log packaging there (~750 B of the deepest path measured with -fstack-usage);
# the driver default of 800 B is not enough headroom.
CONFIG_IEEE802154_RF2XX_RX_STACK_SIZE=2048
CONFIG_NET_PKT_TX_COUNT=2
CONFIG_NET_PKT_RX_COUNT=8
CONFIG_NET_BUF_DATA_SIZE=128
CONFIG_RADIO=y
CONFIG_GPIO=y
CONFIG_LOG=y
# rf2xx CSMA backoff needs rand; no TRNG driver on this board, use test RNG
CONFIG_TEST_RANDOM_GENERATOR=y

# Console line input for the `dump`/`reset`/`stats` commands the host monitor
# uses to pull the on-target per-frame ring buffer in bulk.
CONFIG_CONSOLE_SUBSYS=y
CONFIG_CONSOLE_GETLINE=y
```

## debug.conf
```kconfig
# Copyright (c) 2026
# SPDX-License-Identifier: Apache-2.0
#
# This is a Kconfig fragment which can be used to enable debug-related options
# in the application. See the README for more details.

# compiler
CONFIG_DEBUG_OPTIMIZATIONS=y

# logging
CONFIG_LOG=y
CONFIG_RADIO_RX_TESTBED_LOG_LEVEL_DBG=y
```

## boards/samr21_xpro.overlay
```dts
/*
 * Copyright (c) 2026
 * SPDX-License-Identifier: Apache-2.0
 */

/* SAM R21 Xplained Pro overlay for the radio RX testbed.
 *
 * The on-board AT86RF233 (SERCOM4 SPI) and LED0 (PA19) come from the base
 * board DTS via the `zephyr,ieee802154` chosen and the `led0` alias, so no
 * extra nodes are needed here. This file exists so the testbed is explicitly
 * samr21-only: there are no overlays for any other board.
 */
```

## src/main.c
```c
/*
 * Copyright (c) 2026
 * SPDX-License-Identifier: Apache-2.0
 *
 * radio-rx-testbed: raw-mode 802.15.4 receiver for samr21_xpro.
 *
 * The receive path lives in the shared lib (lib/radio/radio_testbed.c):
 * raw mode leaves net_recv_data() undefined, so the lib provides it. It
 * classifies each frame as ours / foreign / malformed, keeps the per-frame
 * data in an on-target ring buffer, and exposes link statistics. This image
 * brings the radio up (channel + filter), sets the expected network so
 * neighbour traffic is reported as *foreign* rather than link loss, and
 * serves a small console command set so the host can pull bulk data:
 *
 *   dump   -> print the ring contents as BULK/BULK_BEGIN/BULK_END log lines
 *   reset  -> clear counters and the ring
 *   stats  -> print the link statistics line now
 *   help   -> list commands
 *
 * Pair with radio-tx-testbed on a second SAM R21 board: same channel,
 * then watch both LEDs blink in step.
 */

#include <errno.h>
#include <string.h>

#include <zephyr/kernel.h>
#include <zephyr/device.h>
#include <zephyr/logging/log.h>
#include <zephyr/console/console.h>

#include <zephyr/net/ieee802154_radio.h>

#include <app/lib/radio_testbed.h>

#include <zephyr/app_version.h>

LOG_MODULE_REGISTER(radio_rx, CONFIG_RADIO_RX_TESTBED_LOG_LEVEL);

/* Must match the TX side (radio-tx-testbed / TX-PLAN.md §6). */
#define RX_CHANNEL     15
#define RX_PAN_ID      0xCAFE
#define RX_SRC_NODE    1

static const struct device *const radio =
	DEVICE_DT_GET(DT_CHOSEN(zephyr_ieee802154));

static void log_link_stats(void)
{
	struct radio_testbed_link_stats st;
	uint32_t ok;

	radio_testbed_link_stats(&st);
	ok = st.ok;

	/* Same parseable shape with and without frames. The monitor's LINK_RE
	 * keys have to be present *before* the first valid frame too, so that a
	 * silent link still yields a `target link` summary line -- and that is
	 * precisely the line that carries `malformed=N`, i.e. where an unstripped
	 * FCS or a codec mismatch shows up. Zeroed RSSI/LQI until ok > 0. */
	LOG_INF("link ok=%u dropped=%u foreign=%u malformed=%u "
		"gaps=%u dups=%u last_seq=%u "
		"rssi_min=%d rssi_max=%d rssi_avg=%d "
		"lqi_min=%u lqi_max=%u lqi_avg=%u",
		ok, st.dropped, st.foreign, st.malformed,
		st.gaps, st.dups,
		(unsigned int)(st.has_seq ? st.last_seq : 0U),
		ok > 0U ? st.rssi_min : 0, ok > 0U ? st.rssi_max : 0,
		ok > 0U ? (int)(st.rssi_sum / (int32_t)ok) : 0,
		ok > 0U ? st.lqi_min : 0U, ok > 0U ? st.lqi_max : 0U,
		ok > 0U ? (unsigned int)(st.lqi_sum / ok) : 0U);
}

/*
 * Console command thread. The host monitor sends `dump\n` over the same
 * serial port it reads logs from; console_getline() gives us a blocking line
 * reader without pulling in the full shell. The dump goes through LOG_INF so
 * it cannot interleave byte-wise with the RX thread's own log output.
 */
#define CMD_STACK_SIZE 1024
K_THREAD_STACK_DEFINE(cmd_stack, CMD_STACK_SIZE);
static struct k_thread cmd_thread_data;

static void cmd_thread(void *a, void *b, void *c)
{
	ARG_UNUSED(a);
	ARG_UNUSED(b);
	ARG_UNUSED(c);

	console_getline_init();

	for (;;) {
		char *line = console_getline();

		if (line == NULL) {
			continue;
		}

		if (strcmp(line, "dump") == 0) {
			radio_testbed_dump();
		} else if (strcmp(line, "reset") == 0) {
			radio_testbed_reset_stats();
			radio_testbed_ring_reset();
			printk("reset ok\n");
		} else if (strcmp(line, "stats") == 0) {
			log_link_stats();
		} else if (strcmp(line, "help") == 0) {
			printk("commands: dump, reset, stats, help\n");
		} else if (line[0] != '\0') {
			printk("unknown command '%s' (try help)\n", line);
		}
	}
}

int main(void)
{
	const struct ieee802154_radio_api *api;
	struct radio_testbed_filter filter = {
		.check_pan = true,
		.pan_id = RX_PAN_ID,
		.check_src = true,
		.src_short_addr = RX_SRC_NODE,
	};
	int ret;

	printk("Radio RX testbed %s (samr21_xpro, ch %d, pan 0x%04x, src %d)\n",
	       APP_VERSION_STRING, RX_CHANNEL, RX_PAN_ID, RX_SRC_NODE);

	if (radio_testbed_led_init() < 0) {
		LOG_WRN("RX LED not ready, continuing without blink");
	}

	radio_testbed_set_filter(&filter);

	k_thread_create(&cmd_thread_data, cmd_stack,
			K_THREAD_STACK_SIZEOF(cmd_stack),
			cmd_thread, NULL, NULL, NULL,
			K_PRIO_PREEMPT(7), 0, K_NO_WAIT);
	k_thread_name_set(&cmd_thread_data, "cmd");

	if (!device_is_ready(radio)) {
		LOG_ERR("Radio not ready");
		return 0;
	}

	api = (const struct ieee802154_radio_api *)radio->api;

	ret = api->set_channel(radio, RX_CHANNEL);
	if (ret < 0) {
		LOG_ERR("set_channel(%d) failed (%d)", RX_CHANNEL, ret);
	}

	/* Testbed: accept any on-channel frame, then classify it against the
	 * filter above. Fail open so a driver that rejects the configure call
	 * still receives with its default filter.
	 */
	{
		struct ieee802154_config cfg = { .promiscuous = true };

		ret = api->configure(radio, IEEE802154_CONFIG_PROMISCUOUS, &cfg);
		if (ret < 0) {
			LOG_WRN("Promiscuous mode refused (%d), using default filter",
				ret);
		}
	}

	ret = api->start(radio);
	if (ret < 0 && ret != -EALREADY) {
		LOG_ERR("Radio start failed (%d)", ret);
		return 0;
	}

	LOG_INF("Listening, LED0 blinks per valid sensor frame; send 'dump' for bulk");

	while (1) {
		k_sleep(K_MSEC(5000));
		log_link_stats();
	}

	return 0;
}
```
