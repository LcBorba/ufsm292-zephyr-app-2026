## drivers/ethernet/Kconfig.ksz8851snl
```kconfig
# SPDX-License-Identifier: Apache-2.0

config ETH_KSZ8851SNL
	bool "Microchip KSZ8851SNL Ethernet controller"
	default y
	depends on ETH_DRIVER && DT_HAS_MICROCHIP_KSZ8851SNL_ENABLED
	select SPI
	select GPIO
	help
	  Enable the KSZ8851SNL 10/100 Ethernet controller with SPI interface.
```

## dts/bindings/ethernet/microchip,ksz8851snl.yaml
```yaml
# SPDX-License-Identifier: Apache-2.0

description: Microchip KSZ8851SNL 10/100 Ethernet controller with SPI interface

compatible: "microchip,ksz8851snl"

include: [spi-device.yaml, ethernet-controller.yaml]

properties:
  int-gpios:
    type: phandle-array
    required: false
    description: Active-low, open-drain interrupt output.

  reset-gpios:
    type: phandle-array
    required: false
    description: Active-low hardware reset input.
```

## lib/Kconfig
```kconfig
# Copyright (c) 2021 Legrand North America, LLC.
# SPDX-License-Identifier: Apache-2.0

menu "Custom libraries"

rsource "custom/Kconfig"
rsource "radio/Kconfig"
rsource "gateway_memory/Kconfig"
rsource "gateway_json/Kconfig"

endmenu
```

## lib/gateway_json/Kconfig
```kconfig
# Copyright (c) 2026
# SPDX-License-Identifier: Apache-2.0

config GATEWAY_JSON
	bool "Gateway sensor JSON encoder"
	depends on GATEWAY_MEMORY
	default y
	help
	  Enables bounded JSON encoding of the latest readings in the Gateway
	  memory table.
```

## lib/gateway_memory/Kconfig
```kconfig
# Copyright (c) 2026
# SPDX-License-Identifier: Apache-2.0

config GATEWAY_MEMORY
        bool "Gateway memory table"
        default y
        help
          Enables the in-memory table that stores the latest reading
          received from each sensor node.
```

## lib/radio/Kconfig
```kconfig
# Copyright (c) 2026
# SPDX-License-Identifier: Apache-2.0

config RADIO
	bool "Shared 802.15.4 sensor-frame codec"
	help
	  Enables the shared sensor-frame encoder/decoder used by the sensor
	  nodes (encode + transmit) and the gateway (receive + decode). The
	  on-air format is the 18-byte payload defined in gateway/AGENTS.md
	  carried in a proper 802.15.4 MAC data frame; see gateway/radio-plan.md.
```
