/*
 * SPDX-License-Identifier: Apache-2.0
 */

 / {
	example_sensor: example-sensor {
		compatible = "zephyr,example-sensor";
		input-gpios = <&porta 11 (GPIO_PULL_UP | GPIO_ACTIVE_LOW)>;
	};

	blink_led: blink-led {
		compatible = "blink-gpio-led";
		led-gpios = <&portb 30 GPIO_ACTIVE_LOW>;
		blink-period-ms = <1000>;
	};
};
